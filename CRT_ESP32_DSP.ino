
#define LED_BUILTIN 2

TaskHandle_t Task1;
TaskHandle_t Task2;




void TaskCode1( void * pcParameters)
{
  while (1) {
    digitalWrite(LED_BUILTIN, HIGH);   // turn the LED on (HIGH is the voltage level)
    delay(500);  
    digitalWrite(LED_BUILTIN, LOW);    // turn the LED off by making the voltage LOW
    delay(100); 
  }
}


// the following are X, Y, X, Y except that a single "255"
// indicatete the following is a "dark" vector (move instead
// of draw)
// the first vector is assumed "dark". Code will not accept a "255"
// at the beginning

// The Hershey font (see paulbourke.net/dataformats/hershey)
const uint16_t hershey_idx[]  = {
  0,2,19,30,51,103,165,235,251,273,295,311,
  322,340,346,358,364,400,410,440,472,485,
  521,569,580,640,688,711,740,748,759,
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  2229,2240,2259,2275,2353,2359,2437};


const uint8_t hershey_font[]  = {
0,16, /* Ascii 32 */
  
15,10, /* Ascii 33 */
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  10,13,10,15,11,18,13,19,15,19,17,18,21,15,23,14,25,14,27,15,28,17,6,6,10,15,11,17,13,18,15,18,17,17,21,14,23,13,25,13,27,14,28,17,28,19,
   
};

#define DAC1 25
#define DAC2 26


// Scale factors for the 8 bits DAC
# define SCALE_X 255.0/255.0
# define SCALE_Y 255.0/255.0




 
void plot(byte x, byte y)
{
    dacWrite(DAC1, x*SCALE_X);
    dacWrite(DAC2, y*SCALE_Y); 
}

/*  Quadrants
    2  |  1
-------|-----
    3  |  4

*/
void vector(byte x1, byte y1, byte x2, byte y2)
{
    // optimized implementation of Bresenham's Algorithm
    // also known as a DDA - digital differential analyzer
    int acc;

    // special routines for horizontal and vertical lines
    // to improve performance of the SPI version
    // aren't needed for the direct-load DAC
#if 1
  if (x1 == x2) { // trivial vertical
        if (y1 < y2)  { // up
            for (; y1 < y2; y1++) {
                plot(x1, y1);
            }
          }
        else {   // down
            for (; y1 > y2; y1--) {
                plot(x1, y1);
            }
         }
    }
    else if (y1 == y2) { // trivial horizontal
        if (x1 < x2) { // right
            for (; x1 < x2; x1++) {
                plot(x1, y1);
            }
        }
        else {  // left
            for (; x1 > x2; x1--) {
                plot(x1, y1);
            }
        }
    }
    else
#endif
    // for speed, there are 8 DDA's, one for each octant
    if (y1 < y2) { // quadrant 1 or 2
        byte dy = y2 - y1;
        if (x1 < x2) { // quadrant 1
            byte dx = x2 - x1;
            if (dx > dy) { // < 45
                acc = (dx >> 1);
                for (; x1 < x2; x1++) {
                    plot(x1, y1);
                    acc -= dy;
                    if (acc < 0) {
                        y1++;
                        acc += dx;
                    }
                }
            }
            else {   // > 45
                acc = dy >> 1;
                for (; y1 < y2; y1++) {
                    plot(x1, y1);
                    acc -= dx;
                    if (acc < 0) {
                        x1++;
                        acc += dy;
                    }
                }
            }
        }
        else {  // quadrant 2
            byte dx = x1 - x2;
            if (dx > dy) { // < 45
                acc = dx >> 1;
                for (; x1 > x2; x1--) {
                    plot(x1, y1);
                    acc -= dy;
                    if (acc < 0) {
                        y1++;
                        acc += dx;
                    }
                }
            }
            else {  // > 45
                acc = dy >> 1;
                for (; y1 < y2; y1++) {
                    plot(x1, y1);
                    acc -= dx;
                    if (acc < 0) {
                        x1--;
                        acc += dy;
                    }
                }
            }        
        }
    }
    else { // quadrant 3 or 4
        byte dy = y1 - y2;
        if (x1 < x2) { // quadrant 4
            byte dx = x2 - x1;
            if (dx > dy) {  // < 45
                acc = dx >> 1;
                for (; x1 < x2; x1++) {
                    plot(x1, y1);
                    acc -= dy;
                    if (acc < 0) {
                        y1--;
                        acc += dx;
                    }
                }
            
            }
            else {  // > 45
                acc = dy >> 1;
                for (; y1 > y2; y1--) {
                    plot(x1, y1);
                    acc -= dx;
                    if (acc < 0) {
                        x1++;
                        acc += dy;
                    }
                }

            }
        }
        else {  // quadrant 3
            byte dx = x1 - x2;
            if (dx > dy) { // < 45
                acc = dx >> 1;
                for (; x1 > x2; x1--) {
                    plot(x1, y1);
                    acc -= dy;
                    if (acc < 0) {
                        y1--;
                        acc += dx;
                    }
                }

            }
            else {  // > 45
                acc = dy >> 1;
                for (; y1 > y2; y1--) {
                    plot(x1, y1);
                    acc -= dx;
                    if (acc < 0) {
                        x1--;
                        acc += dy;
                    }
                }
            }
        }
    
    }
}

/* ------------------------------------------------
 *  Draw the content of a buffer 
 * ------------------------------------------------*/
void draw(prog_uchar *image, int imagesize) {
    bool darkvector = false;
    int i = 0;
    byte x1 = pgm_read_byte_near(image+i++);
    byte y1 = pgm_read_byte_near(image+i++);
    while (i < imagesize) {
        byte x2 = pgm_read_byte_near(image+i++);
        if (x2 == 255) { // dark vector (move)
            x2 = pgm_read_byte_near(image+i++);
            darkvector = true;
        }
        byte y2 = pgm_read_byte_near(image+i++);
        if (!darkvector) vector(x1, y1, x2, y2);
        else darkvector = false;
        x1 = x2;
        y1 = y2;
    }
}

/* ------------------------------------------------
 *  Draw a character at position x,y
 * ------------------------------------------------*/
void drawchar(const uint8_t *font, const uint16_t *fontidx, char c, byte x, byte y) {
    bool darkvector = false;
    int idx = pgm_read_word_near(fontidx+(c-32));
    int end_byte = idx+pgm_read_byte_near(font+idx++)+1;
    int width = pgm_read_byte_near(font+idx++);
    byte x1 = pgm_read_byte_near(font+idx++);
    byte y1 = pgm_read_byte_near(font+idx++);
    while ( idx < end_byte) {
        byte x2 = pgm_read_byte_near(font+idx++);
        if (x2 == 255) { // dark vector (move)
            x2 = pgm_read_byte_near(font+idx++);
            darkvector = true;
        }
        byte y2 = pgm_read_byte_near(font+idx++);
        if (!darkvector) vector(x+x1, y+y1, x+x2, y+y2);
        else darkvector = false;
        x1 = x2;
        y1 = y2;
    }
}

unsigned char width(const uint8_t *font, const uint16_t *fontidx, char c) {
    int idx = pgm_read_word_near(fontidx+(c-32));
    return pgm_read_byte_near(font+idx+1);
}

void draw_string(const uint8_t *font, const uint16_t *fontidx, char* s, int x, int y) {
  int i=0;
  char c;
  while ( c=s[i++]) {
    drawchar(hershey_font, hershey_idx, c, x,y);
    x+= width(hershey_font, hershey_idx, c)+2;
  }
}

TaskHandle_t dsptask_hnd;


void dsptask_code ( void* pvParameters )
{
  int mode=0;
  int i=0;
  while(1) {
    i++;
    if (i==50) {  i=0;}
    if (mode == 2) mode =0;
    switch (mode) {
      case 0: 
        draw_string(hershey_font, hershey_idx, "Second line", 0,100);
        draw_string(hershey_font, hershey_idx, "Eric did it!", 0,200);
        draw_string(hershey_font, hershey_idx, "Hershey font", 0,50);
        break;
      case 1:
        vector(0,0,255,0);
        vector(255,0,255,255);
        vector(255,255,0,255);
        vector(0,255,0,0);
        break;
      default:
        break;
    }
  }
}

void setup() {

    // initialize digital pin LED_BUILTIN as an output.
  pinMode(LED_BUILTIN, OUTPUT);

  xTaskCreatePinnedToCore(
    dsptask_code,
    "Task 1",
    10000,
    NULL,
    1,&dsptask_hnd,0);
     
}

void loop() 
{

}
